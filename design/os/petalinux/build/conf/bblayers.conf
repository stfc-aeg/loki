## design/os/petalinux/build/misc/rootfs_config/Kconfig.user
```kconfig
menu "apps " 
config startup  
	 bool "startup"
	 help
	Simple startup application
	
config webfwu  
	 bool "webfwu"
	 help
	Simple webfwu application
	
endmenu
menu "user packages " 
config gpio-demo  
	 bool "gpio-demo"
	 help
	
config peekpoke  
	 bool "peekpoke"
	 help
	
endmenu
```

## os/petalinux-custom/project-spec/configs/rootfsconfigs/Kconfig.user
```kconfig
menu "user packages " 
config libgpiod-python  
	 bool "libgpiod-python"
	 help
	
config gpio-demo  
	 bool "gpio-demo"
	 help
	
config odin-control  
	 bool "odin-control"
	 help
	
config odin-devices  
	 bool "odin-devices"
	 help
	
config odin-sequencer  
	 bool "odin-sequencer"
	 help
	
config peekpoke  
	 bool "peekpoke"
	 help
	
config python3-pip  
	 bool "python3-pip"
	 help
	
config python3-psutil  
	 bool "python3-psutil"
	 help
	
config python3-pyzmq  
	 bool "python3-pyzmq"
	 help
	
config python3-requests  
	 bool "python3-requests"
	 help
	
config python3-smbus  
	 bool "python3-smbus"
	 help
	
config python3-spidev  
	 bool "python3-spidev"
	 help
	
config spidev-test  
	 bool "spidev-test"
	 help
	
config start-stop-daemon  
	 bool "start-stop-daemon"
	 help
	
endmenu
```

## os/petalinux-custom/project-spec/meta-user/conf/layer.conf
```bitbake
# We have a conf and classes directory, add to BBPATH
BBPATH .= ":${LAYERDIR}"

# We have recipes-* directories, add to BBFILES
BBFILES += "${LAYERDIR}/recipes-*/*/*.bb \
	${LAYERDIR}/recipes-*/*/*.bbappend"

BBFILE_COLLECTIONS += "meta-loki-bsp-legacy"
BBFILE_PATTERN_meta-loki-bsp-legacy = "^${LAYERDIR}/"
BBFILE_PRIORITY_meta-loki-bsp-legacy = "8"
LAYERSERIES_COMPAT_meta-loki-bsp-legacy = "langdale"

OE_TERMINAL = "screen"
SIGGEN_UNLOCKED_RECIPES += " dropbear tzdata"
IMAGE_INSTALL:append = " libgpiod-tools nfs-utils git ntp ntpdate ntpq sntp tzdata parted u-boot-tools python-loki-adapter loki-user loki-config loki-update"
```

## os/petalinux-custom/project-spec/meta-user/conf/machine/loki_rev1.conf
```bitbake
#@TYPE: Machine
#@NAME: LOKI Carrier Revision 1
#@DESCRIPTION: LOKI Carrier Revision 1, with no modifications to mux addresses

# Inherit overrides from zynqmp-generic
MACHINE_OVERRIDES =. "zynqmp-generic:"

# Also inherit the parent configuration
require conf/machine/zynqmp-generic.conf

# Any machine-specific configuration below:
```
